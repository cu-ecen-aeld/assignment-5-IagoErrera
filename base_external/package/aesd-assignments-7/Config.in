## base_external/package/aesd-assignments-7/Config.in
```kconfig
config BR2_PACKAGE_AESD_ASSIGNMENTS_7
	bool "AESD ASSIGNMENTS 7"
	depends on BR2_LINUX_KERNEL
	help
		Include scull and misc-modules of assignment 7
```
